## config/west.yml
```yaml
manifest:
  remotes:
    - name: zmkfirmware
      url-base: https://github.com/zmkfirmware
    - name: lennyitb
      url-base: https://github.com/lennyitb
  projects:
    - name: zmk
      remote: zmkfirmware
      revision: v0.3
      import: app/west.yml
    - name: zmk-layer-report
      remote: lennyitb
      revision: main
  self:
    path: config
```
